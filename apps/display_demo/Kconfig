## apps/display_demo/Kconfig
```kconfig
# Copyright (c) 2020 Robert Wilbrandt
# SPDX-License-Identifier: BSD-3-Clause

mainmenu "microROS_zephyr_display_demo"

# This is required, as otherwise all other Kconfig definitions for the .prj files cannot be found
source "Kconfig.zephyr"
```

## zephyr_modules/l3gd20_driver/Kconfig
```kconfig
# Copyright (c) 2020 Robert Wilbrandt
# SPDX-License-Identifier: BSD-3-Clause

if SENSOR

rsource "l3gd20/Kconfig"

endif
```

## zephyr_modules/l3gd20_driver/dts/bindings/st,l3gd20.yaml
```yaml
# Copyright (c) 2020 Robert Wilbrandt
# SPDX-License-Identifier: BSD-3-Clause

description: STMicroelectronics L3GD20 3-axis gyroscope

compatible: "st,l3gd20"

include: spi-device.yaml
```

## zephyr_modules/l3gd20_driver/l3gd20/Kconfig
```kconfig
# Copyright (c) 2020 Robert Wilbrandt
# SPDX-License-Identifier: BSD-3-Clause
#
# L3GD20 3-axis gyroscope configuration options

menuconfig L3GD20
  bool "L3GD20 3-Axis Gyroscope"
  depends on SPI
  help
    Enable SPI-based driver for the l3gd20 3-axis gyroscope
```

## zephyr_modules/l3gd20h_driver/dts/bindings/st,l3gd20h.yaml
```yaml
description: STMicroelectronics L3GD20h 3-axis gyroscope

compatible: "st,l3gd20h"

include: spi-device.yaml
```

## zephyr_modules/l3gd20h_driver/l3gd20h/Kconfig
```kconfig
# L3GD20H 3-Axis Gyroscope configuration options

menuconfig L3GD20H
  bool "L3GD20H 3-Axis Gyroscope"
  depends on SPI
  help
    Enable SPI-based driver for the l3gd20h 3-axis gyroscope
```
